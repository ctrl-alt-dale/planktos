/* [TYPE: IMPLEMENTATION]
display.c | SSD1306 display driver — 128×64 OLED via hardware I2C

Coordinate system
─────────────────
  Every function in this file operates exclusively in absolute screen
  coordinates: (0,0) = top-left, x right, y down.
  Valid range: x ∈ [0, DISPLAY_W-1], y ∈ [0, DISPLAY_H-1].

  ax()/ay()/SCREEN_CX/SCREEN_CY have been removed.  No implicit
  centering occurs anywhere below.  The center-offset helpers cx()/cy()
  declared in display.h are for external callers only.

  The FRAM addressing, SSD1306 I2C protocol layer, and bit-level
  put_pixel write path are unchanged.
*/
#pragma GCC optimize("O2")
#include "display.h"
#include "twi.h"
#include "fram.h"
#include <avr/io.h>
#include <stdbool.h>
#include <string.h>
#include <stdlib.h>
#include <avr/pgmspace.h>

extern void delay(unsigned long ms);

/* ── Constants ──────────────────────────────────────────────────── */

#define DISPLAY_W 128
#define DISPLAY_H 64
#define BYTES_PER_ROW 16              // 128 bits / 8
#define DISPLAY_PAGES (DISPLAY_H / 8) /* 8 pages of 8 rows each */

#define ADDR 0x3C
#define SLA_W (ADDR << 1)

/* ── Cohen–Sutherland clip codes — absolute coordinate space ─────── */

#define X_MIN 0
#define X_MAX (DISPLAY_W - 1) /* 127 */
#define Y_MIN 0
#define Y_MAX (DISPLAY_H - 1) /*  63 */

#define INSIDE 0
#define LEFT 1
#define RIGHT 2
#define BOTTOM 4
#define TOP 8

// boot screen data
const uint8_t planktos[] PROGMEM = {
  0x00, 0x00, 0x00, 0x00, 0x00, 0x00, 0x00, 0x00, 0x00, 0x00, 0x00, 0x00, 0x00, 0x00, 0x00, 0x00,
  0x00, 0x00, 0x00, 0x00, 0x00, 0x00, 0x00, 0x00, 0x00, 0x00, 0x00, 0x00, 0x00, 0x00, 0x00, 0x00,
  0x00, 0x00, 0x00, 0x00, 0x00, 0x00, 0x00, 0x00, 0x00, 0x00, 0x00, 0x00, 0x00, 0x00, 0x00, 0x00,
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  0x00, 0x00, 0x00, 0x00, 0x00, 0x00, 0x00, 0x00, 0x00, 0x00, 0x00, 0x00, 0x00, 0x00, 0x00, 0x00
};
// end boot screen data





/* ── Forward declaration ────────────────────────────────────────── */

static void put_pixel(uint8_t x, uint8_t y, bool inv);

/* ── SSD1306 command helpers (unchanged) ────────────────────────── */

static void cmd(uint8_t c) {
  twi_start();
  twi_write(SLA_W);
  twi_write(0x00);
  twi_write(c);
  twi_stop();
}

static void cmd_batch(const uint8_t *cmds, uint8_t len) {
  twi_start();
  twi_write(SLA_W);
  twi_write(0x00);
  for (uint8_t i = 0; i < len; i++) twi_write(cmds[i]);
  twi_stop();
}

static const uint8_t init_seq[] = {
  0xAE, 0xD5, 0xF0, 0xA8, 0x3F, 0xD3, 0x00, 0x40,
  0x8D, 0x14, 0x20, 0x00, 0xA1, 0xC8, 0xDA, 0x12,
  0x81, 0xCF, 0xD9, 0x11, 0xDB, 0x20, 0xA4, 0xA6, 0xAF
};

static void set_full_window(void) {
  cmd(0x21);
  cmd(0);
  cmd(DISPLAY_W - 1); /* column range: 0–127 */
  cmd(0x22);
  cmd(0);
  cmd(DISPLAY_PAGES - 1); /* page   range: 0–7   */
}

/* ── Framebuffer: bit-level write (unchanged) ───────────────────── *
 *                                                                    *
 *  put_pixel operates in absolute screen coordinates (0,0 = top-left)*
 *  Framebuffer layout in FRAM:                                       *
 *    addr = FRAM_FB_BASE + x + (y / 8) * DISPLAY_W                  *
 *    bit  = y % 8                                                    *
 *                                                                    *
 *  This function is the only path that writes to FRAM; all higher-   *
 *  level primitives call through here.                               *
 * ─────────────────────────────────────────────────────────────────── */
static void put_pixel(uint8_t x, uint8_t y, bool inv) {
  /* Bounds check — callers may pass clipped coords, guard anyway. */
  if (x >= DISPLAY_W || y >= DISPLAY_H) return;

  uint16_t addr = FRAM_FB_BASE
                  + (uint16_t)x
                  + ((uint16_t)y / 8u) * DISPLAY_W;
  uint8_t mask = 1u << ((uint8_t)y % 8u);
  uint8_t byte = fram_read_byte(addr);
  if (!inv) byte |= mask;
  else byte &= ~mask;
  fram_write_byte(addr, byte);
}

/* ── Cohen–Sutherland line clipping (absolute coordinates) ─────── */

static uint8_t compute_code(int16_t x, int16_t y) {
  uint8_t code = INSIDE;
  if (x < X_MIN) code |= LEFT;
  else if (x > X_MAX) code |= RIGHT;
  if (y < Y_MIN) code |= TOP;
  else if (y > Y_MAX) code |= BOTTOM;
  return code;
}

/*
 * clip_line — Cohen–Sutherland.
 * Works with signed int16 internally so intermediate products do not
 * overflow on AVR (the screen is 128×64; intermediate values stay well
 * within int16 range).
 * Returns 1 if the segment (partially) lies inside the viewport,
 * 0 if it is entirely outside.
 */
static uint8_t clip_line(int16_t *x0, int16_t *y0,
                         int16_t *x1, int16_t *y1) {
  uint8_t code0 = compute_code(*x0, *y0);
  uint8_t code1 = compute_code(*x1, *y1);

  while (1) {
    if (!(code0 | code1)) return 1; /* trivially inside  */
    if (code0 & code1) return 0;    /* trivially outside */

    uint8_t out = code0 ? code0 : code1;

    int32_t dx = (int32_t)(*x1 - *x0);
    int32_t dy = (int32_t)(*y1 - *y0);

    /* Degenerate: zero-length projection on the clipping axis → reject */
    if ((out & (TOP | BOTTOM)) && dy == 0) return 0;
    if ((out & (LEFT | RIGHT)) && dx == 0) return 0;

    int16_t x, y;

    if (out & TOP) {
      x = (int16_t)(*x0 + dx * ((int32_t)Y_MIN - *y0) / dy);
      y = Y_MIN; /* top edge: y = 0 */
    } else if (out & BOTTOM) {
      x = (int16_t)(*x0 + dx * ((int32_t)Y_MAX - *y0) / dy);
      y = Y_MAX; /* bottom edge: y = 63 */
    } else if (out & RIGHT) {
      y = (int16_t)(*y0 + dy * ((int32_t)X_MAX - *x0) / dx);
      x = X_MAX;
    } else {
      y = (int16_t)(*y0 + dy * ((int32_t)X_MIN - *x0) / dx);
      x = X_MIN;
    }

    if (out == code0) {
      *x0 = x;
      *y0 = y;
      code0 = compute_code(*x0, *y0);
    } else {
      *x1 = x;
      *y1 = y;
      code1 = compute_code(*x1, *y1);
    }
  }
}

/* ── Internal Bresenham line (absolute coords, after clipping) ─── */

static void line_abs(int16_t x0, int16_t y0,
                     int16_t x1, int16_t y1, bool inv) {
  if (!clip_line(&x0, &y0, &x1, &y1)) return;

  int16_t dx = abs(x1 - x0);
  int16_t dy = abs(y1 - y0);
  int16_t sx = (x0 < x1) ? 1 : -1;
  int16_t sy = (y0 < y1) ? 1 : -1;
  int16_t err = dx - dy;

  while (1) {
    /* Coordinates are guaranteed in-range after clipping. */
    put_pixel((uint8_t)x0, (uint8_t)y0, inv);
    if (x0 == x1 && y0 == y1) break;
    int16_t e2 = err << 1;
    if (e2 > -dy) {
      err -= dy;
      x0 += sx;
    }
    if (e2 < dx) {
      err += dx;
      y0 += sy;
    }
  }
}

/* ── Public API ─────────────────────────────────────────────────── */

void display_init(void) {
  twi_init();
  delay(100);
  cmd_batch(init_seq, sizeof(init_seq));
  fram_init();
  clf();
  display_render();
}

/* clf — zero the FRAM framebuffer, one 128-byte page at a time */
void clf(void) {
  uint8_t zeros[DISPLAY_W];
  memset(zeros, 0, DISPLAY_W);
  for (uint8_t page = 0; page < DISPLAY_PAGES; page++)
    fram_write_buf(FRAM_FB_BASE + (uint16_t)page * DISPLAY_W,
                   zeros, DISPLAY_W);
}

/* cls — clear framebuffer and push to display */
void cls(void) {
  clf();
  display_render();
}

/* display_render — stream FRAM framebuffer to SSD1306, one page at a time */
void display_render(void) {
  uint8_t buf[DISPLAY_W];
  set_full_window();
  for (uint8_t page = 0; page < DISPLAY_PAGES; page++) {
    fram_read_buf(FRAM_FB_BASE + (uint16_t)page * DISPLAY_W, buf, DISPLAY_W);
    twi_start();
    twi_write(SLA_W);
    twi_write(0x40); /* data stream control byte */
    for (uint16_t i = 0; i < DISPLAY_W; i++) twi_write(buf[i]);
    twi_stop();
  }
}


/* draw_pixel — plot a single pixel at absolute (x, y) */
void draw_pixel(uint8_t x, uint8_t y, bool inv) {
  put_pixel(x, y, inv);
}

void draw_boot(uint8_t offsetX, uint8_t offsetY) {
  for (uint8_t y = 0; y < DISPLAY_H; y++) {
    for (uint8_t byte_idx = 0; byte_idx < BYTES_PER_ROW; byte_idx++) {
      uint8_t b = pgm_read_byte(&planktos[y * BYTES_PER_ROW + byte_idx]);

      for (uint8_t bit = 0; bit < 8; bit++) {
        if (b & (0x80 >> bit)) {
          uint8_t x = (byte_idx << 3) | bit;
          put_pixel(offsetX + x, offsetY + y, false);
        }
      }
    }
  }
}



/* draw_line — Bresenham line from (x0,y0) to (x1,y1), with clipping */
void draw_line(uint8_t x0, uint8_t y0,
               uint8_t x1, uint8_t y1, bool inv) {
  line_abs((int16_t)x0, (int16_t)y0,
           (int16_t)x1, (int16_t)y1, inv);
}

/* draw_hline — horizontal line from x=x0 to x=x1 at row y (inclusive) */
void draw_hline(uint8_t x0, uint8_t x1, uint8_t y, bool inv) {
  if (y >= DISPLAY_H) return;
  if (x0 > x1) {
    uint8_t t = x0;
    x0 = x1;
    x1 = t;
  } /* normalise */
  if (x1 >= DISPLAY_W) x1 = DISPLAY_W - 1;
  for (uint8_t x = x0; x <= x1; x++)
    put_pixel(x, y, inv);
}

/* draw_vline — vertical line from y=y0 to y=y1 at column x (inclusive) */
void draw_vline(uint8_t y0, uint8_t y1, uint8_t x, bool inv) {
  if (x >= DISPLAY_W) return;
  if (y0 > y1) {
    uint8_t t = y0;
    y0 = y1;
    y1 = t;
  } /* normalise */
  if (y1 >= DISPLAY_H) y1 = DISPLAY_H - 1;
  for (uint8_t y = y0; y <= y1; y++)
    put_pixel(x, y, inv);
}

/* draw_rect — outline or filled rectangle.
 * (x, y) = top-left corner, w = width, h = height (in pixels). */
void draw_rect(uint8_t x, uint8_t y,
               uint8_t w, uint8_t h, bool inv, bool filled) {
  if (w == 0 || h == 0) return;
  if (x >= DISPLAY_W || y >= DISPLAY_H) return;

  uint8_t x1 = (x + w - 1 < DISPLAY_W) ? (uint8_t)(x + w - 1) : (DISPLAY_W - 1);
  uint8_t y1 = (y + h - 1 < DISPLAY_H) ? (uint8_t)(y + h - 1) : (DISPLAY_H - 1);

  if (filled) {
    for (uint8_t row = y; row <= y1; row++)
      for (uint8_t col = x; col <= x1; col++)
        put_pixel(col, row, inv);
  } else {
    /* top and bottom edges */
    for (uint8_t col = x; col <= x1; col++) {
      put_pixel(col, y, inv);
      put_pixel(col, y1, inv);
    }
    /* left and right edges (skip corners already drawn) */
    for (uint8_t row = (uint8_t)(y + 1); row < y1; row++) {
      put_pixel(x, row, inv);
      put_pixel(x1, row, inv);
    }
  }
}

/* draw_circle — outline or filled circle centred at (x, y) with radius r.
 * Uses Bresenham's midpoint algorithm.
 * Filled path draws horizontal spans; no pixel is written more than twice. */
void draw_circle(uint8_t x, uint8_t y, uint8_t r, bool inv, bool filled) {
  int16_t cx = (int16_t)x;
  int16_t cy = (int16_t)y;
  int16_t px = (int16_t)r;
  int16_t py = 0;
  int16_t err = 0;

  while (px >= py) {
    if (filled) {
      /* Draw four horizontal spans covering all eight octants */
      if (cy + py >= 0 && cy + py < DISPLAY_H)
        draw_hline(
          (uint8_t)((cx - px < 0) ? 0 : (uint8_t)(cx - px)),
          (uint8_t)((cx + px >= DISPLAY_W) ? DISPLAY_W - 1 : (uint8_t)(cx + px)),
          (uint8_t)(cy + py), inv);

      if (cy - py >= 0 && cy - py < DISPLAY_H)
        draw_hline(
          (uint8_t)((cx - px < 0) ? 0 : (uint8_t)(cx - px)),
          (uint8_t)((cx + px >= DISPLAY_W) ? DISPLAY_W - 1 : (uint8_t)(cx + px)),
          (uint8_t)(cy - py), inv);

      if (cy + px >= 0 && cy + px < DISPLAY_H)
        draw_hline(
          (uint8_t)((cx - py < 0) ? 0 : (uint8_t)(cx - py)),
          (uint8_t)((cx + py >= DISPLAY_W) ? DISPLAY_W - 1 : (uint8_t)(cx + py)),
          (uint8_t)(cy + px), inv);

      if (cy - px >= 0 && cy - px < DISPLAY_H)
        draw_hline(
          (uint8_t)((cx - py < 0) ? 0 : (uint8_t)(cx - py)),
          (uint8_t)((cx + py >= DISPLAY_W) ? DISPLAY_W - 1 : (uint8_t)(cx + py)),
          (uint8_t)(cy - px), inv);
    } else {
      /* Eight-way symmetric outline — bounds-checked via put_pixel */
      int16_t pts[8][2] = {
        { cx + px, cy + py },
        { cx - px, cy + py },
        { cx + px, cy - py },
        { cx - px, cy - py },
        { cx + py, cy + px },
        { cx - py, cy + px },
        { cx + py, cy - px },
        { cx - py, cy - px },
      };
      for (uint8_t i = 0; i < 8; i++) {
        if (pts[i][0] >= 0 && pts[i][0] < DISPLAY_W && pts[i][1] >= 0 && pts[i][1] < DISPLAY_H)
          put_pixel((uint8_t)pts[i][0], (uint8_t)pts[i][1], inv);
      }
    }

    py++;
    if (err <= 0) {
      err += 2 * py + 1;
    } else {
      px--;
      err += 2 * (py - px) + 1;
    }
  }
}

/* draw_triangle — triangle outline via three clipped Bresenham lines */
void draw_triangle(uint8_t x1, uint8_t y1,
                   uint8_t x2, uint8_t y2,
                   uint8_t x3, uint8_t y3, bool inv) {
  draw_line(x1, y1, x2, y2, inv);
  draw_line(x2, y2, x3, y3, inv);
  draw_line(x3, y3, x1, y1, inv);
}
